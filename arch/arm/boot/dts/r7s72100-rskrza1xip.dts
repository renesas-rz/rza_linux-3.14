/*
 * Device Tree Source for the RSKRZA1 board
 *
 * Copyright (C) 2014 Renesas America
 *
 * This file is licensed under the terms of the GNU General Public License
 * version 2.  This program is licensed "as is" without any warranty of any
 * kind, whether express or implied.
 */

/dts-v1/;
#include "r7s72100.dtsi"

/ {
	model = "RSKRZA1";
	compatible = "renesas,rskrza1", "renesas,r7s72100";

	chosen {
		//bootargs = "console=ttySC2,115200 earlyprintk=sh-sci.2,115200 ignore_loglevel initcall_debug"; /* debug boot */
		//bootargs = "console=ttySC2,115200 ignore_loglevel"; /* initramfs boot */
		bootargs = "console=ttySC2,115200 ignore_loglevel root=/dev/nfs \
ip=192.168.0.55:192.168.0.1:192.168.0.1:255.255.255.0:rskrza1:eth0:off  \
nfsroot=192.168.0.1:/home/renesas/rza1/busybox-1.21.0/_install_nfs"  ; /* nfs boot */

	};

	memory {
		device_type = "memory";
		//reg = <0x09000000 0x01000000>;		// 16MB at 0x09000000 (SDRAM)
		reg = <0x20000000 0x00A00000>;		// 10MB at 0x20000000 (RAM)
	};

	lbsc {
		#address-cells = <1>;
		#size-cells = <1>;
	};
};

